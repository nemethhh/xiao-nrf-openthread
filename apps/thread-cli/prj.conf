## CMakeLists.txt
```
#
# Copyright (c) 2020 Nordic Semiconductor ASA
#
# SPDX-License-Identifier: LicenseRef-Nordic-5-Clause
#
# Derived from nrf/samples/openthread/cli (NCS v3.4.1): FTD with the OpenThread CLI.
cmake_minimum_required(VERSION 3.20.0)

find_package(Zephyr REQUIRED HINTS $ENV{ZEPHYR_BASE})

project(thread_cli)

target_sources(app PRIVATE src/main.c)
```

## Kconfig
```
#
# Copyright (c) 2020 Nordic Semiconductor ASA
#
# SPDX-License-Identifier: LicenseRef-Nordic-5-Clause
#

menu "Zephyr Kernel"
source "Kconfig.zephyr"
endmenu

module = OT_COMMAND_LINE_INTERFACE
module-str = ot_cli
source "$(ZEPHYR_BASE)/subsys/logging/Kconfig.template.log_config"
```

## prj.conf
```kconfig
#
# Copyright (c) 2020 Nordic Semiconductor
#
# SPDX-License-Identifier: LicenseRef-Nordic-5-Clause
#

# Enable OpenThread
CONFIG_OPENTHREAD=y

# Network shell
CONFIG_SHELL=y
CONFIG_OPENTHREAD_SHELL=y
CONFIG_SHELL_ARGC_MAX=26
CONFIG_SHELL_CMD_BUFF_SIZE=416

# The router design depends on these (explicit, not NCS defaults): a node never forms a network on its
# own (main.c starts OpenThread only when a dataset is stored), and Thread settings persist in ZMS on RRAM.
CONFIG_OPENTHREAD_MANUAL_START=y
CONFIG_SETTINGS=y
CONFIG_ZMS=y
CONFIG_SETTINGS_ZMS=y
CONFIG_OPENTHREAD_SETTINGS_RAM=n

# Enable OpenThread features set
CONFIG_OPENTHREAD_NORDIC_LIBRARY_MASTER=y

CONFIG_GPIO_SHELL=y
```

## boards/xiao_ble_nrf52840.conf
```kconfig
#
# XIAO nRF52840 (xiao_ble) as a permanent Thread router: shell and console over the native USB
# CDC ACM port (the board DTS already chooses board_cdc_acm_uart for console and shell).
# Mirrors NCS's samples/openthread/cli/boards/nrf52840dongle_nrf52840.conf, minus the dongle's
# bootloader-reset GPIO (the XIAO's Adafruit UF2 bootloader is entered by double-tapping reset).
#
# Headless: Thread never waits for a host. USB comes up at boot on its own, OpenThread starts from
# main() when a dataset is stored, and only the shell thread holds its output until a host asserts DTR
# (SHELL_BACKEND_SERIAL_CHECK_DTR, the board default); printk drops bytes rather than block.
CONFIG_USB_DEVICE_STACK_NEXT=y
CONFIG_CDC_ACM_SERIAL_INITIALIZE_AT_BOOT=y
CONFIG_CDC_ACM_SERIAL_MANUFACTURER_STRING="Seeed Studio"
CONFIG_CDC_ACM_SERIAL_PRODUCT_STRING="XIAO nRF52840 Thread Router"
CONFIG_UART_LINE_CTRL=y
CONFIG_SHELL_BACKEND_SERIAL_CHECK_DTR=y
# The shell backend must initialise after the CDC ACM device (as in the NCS dongle config).
CONFIG_SHELL_BACKEND_SERIAL_INIT_PRIORITY=51
# USB delivers a pasted line in 64-byte bursts, faster than the shell drains them: with the default 64-byte
# RX ring the rest of a long line is dropped (seen live: `ot dataset set active <tlv>` lost everything after
# 64 characters, no Done, no error). Hold a whole command buffer (SHELL_CMD_BUFF_SIZE=416 in prj.conf).
CONFIG_SHELL_BACKEND_SERIAL_RX_RING_BUFFER_SIZE=512
# tools/fw.py reboots a running router into the UF2 bootloader through `devmem` (GPREGRET = 0x57), so
# re-flashing needs no reset double-tap. Enabled by default here already; explicit because the tool relies on it.
CONFIG_DEVMEM_SHELL=y
```

## src/main.c
```c
/*
 * Copyright (c) 2020 Nordic Semiconductor ASA
 *
 * SPDX-License-Identifier: LicenseRef-Nordic-5-Clause
 */

#include <zephyr/kernel.h>
#include <zephyr/devicetree.h>
#include <zephyr/logging/log.h>
#include <openthread.h>
#include <openthread/dataset.h>

LOG_MODULE_REGISTER(thread_cli, CONFIG_OT_COMMAND_LINE_INTERFACE_LOG_LEVEL);

/* The XIAO's RF switch selects the ceramic antenna while rfsw-ctl is driven at boot
 * (regulator-boot-on) and the U.FL connector when it idles; see overlays/antenna-external.overlay.
 */
#if DT_NODE_EXISTS(DT_NODELABEL(rfsw_ctl))
#define ANTENNA (DT_PROP(DT_NODELABEL(rfsw_ctl), regulator_boot_on) ? "internal" : "external")
#else
#define ANTENNA "n/a"
#endif

int main(void)
{
	printk("thread-cli: antenna=%s\n", ANTENNA);

	/* OpenThread is started manually so a fresh node never forms a network from Kconfig
	 * defaults; a node that already has a network (settings survived reboot) rejoins it.
	 */
	openthread_mutex_lock();
	bool commissioned = otDatasetIsCommissioned(openthread_get_default_instance());
	openthread_mutex_unlock();

	if (commissioned) {
		int err = openthread_run();

		LOG_INF("Rejoining stored Thread network: %d", err);
	}

	LOG_INF("OpenThread CLI running. Use 'ot <command>', e.g. 'ot state'.");
	return 0;
}
```
